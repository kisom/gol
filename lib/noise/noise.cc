#include <Arduino.h>
#include <math.h> 
#include <noise.h>
#include <util.h>


namespace noise {

// C++ conversion of Ken Perlin's improved noise generator from
// https://mrl.nyu.edu/~perlin/noise/

static const uint8_t perlinDefaultPermutation[] = {
	151, 160, 137, 91,  90,  15,  131, 13,  201, 95,  96,  53,  194, 233, 7,
	225, 140, 36,  103, 30,  69,  142, 8,   99,  37,  240, 21,  10,  23,  190,
	6,   148, 247, 120, 234, 75,  0,   26,  197, 62,  94,  252, 219, 203, 117,
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	222, 114, 67,  29,  24,  72,  243, 141, 128, 195, 78,  66,  215, 61,  156,
	180
};

static double
grad(int hash, double x, double y, double z)
{
	// http://riven8192.blogspot.com/2010/08/calculate-perlinnoise-twice-as-fast.html
	switch(hash & 0xF)
	{
		case 0x0: return  x + y;
		case 0x1: return -x + y;
		case 0x2: return  x - y;
		case 0x3: return -x - y;
		case 0x4: return  x + z;
		case 0x5: return -x + z;
		case 0x6: return  x - z;
		case 0x7: return -x - z;
		case 0x8: return  y + z;
		case 0x9: return -y + z;
		case 0xA: return  y - z;
		case 0xB: return -y - z;
		case 0xC: return  y + x;
		case 0xD: return -y + z;
		case 0xE: return  y - x;
		case 0xF: return -y - z;
		default: return 0; // never happens
	}
}


static double
lerp(double t, double a, double b)
{
	return a + t * (b - a);
}


static double
fade(double t)
{
	return t * t * t * (t * (t * 6 - 15) + 10);
}


void
NoiseGenerator::randomPermutation()
{
	// Generate a random permutation of 256 values from 0 to 255
	// inclusive. This is generated by setting each value in the
	// array to its index value, then putting it through a
	// Fisher-Yates shuffle.
	for (int i = 0; i < 256; i++) {
		perm[i] = i;
	}

	for (int i = 255; i > 0; i--) {
		int j = random(0, i+1);
		swap_u8(perm[i], perm[j]);
	}

	for (int i = 0; i < 256; i++) {
		p[i] = perm[i];
		p[i+256] = perm[i];
	}
}


NoiseGenerator::NoiseGenerator()
{
	this->randomPermutation();
}


NoiseGenerator::NoiseGenerator(bool standard)
{
	if (standard) {
		for (int i = 0; i < 256; i++) {
			p[i] = perlinDefaultPermutation[i];
		}
		
		for (int i = 0; i < 256; i++) {
			p[i] = perm[i];
			p[i+256] = perm[i];
		}
	}
	else {
		this->randomPermutation();
	}
}


double
NoiseGenerator::sample(double x, double y, double z)
{
	uint16_t	ux = (uint16_t)floor(x) & 255;
	uint16_t	uy = (uint16_t)floor(y) & 255;
	uint16_t	uz = (uint16_t)floor(z) & 255;
	double		u, v, w;
	uint16_t	a, aa, ab, b, ba, bb;

	x -= floor(x);
	u = fade(x);

	y -= floor(y);
	v = fade(y);

	z -= floor(z);
	w = fade(z);

	a = p[ux] + uy;
	aa = p[a] + uz;
	ab = p[a + 1] + uz;

	b = p[ux + 1] + uy;
	ba = p[b] + uz;
	bb = p[b + 1] + uz;

	return lerp(w, lerp(v, lerp(u, grad(p[aa], x, y, z),
					grad(p[ba], x-1, y, z)),
				lerp(u, grad(p[ab], x, y-1, z),
					grad(p[bb], x-1, y-1, z))),
		       lerp(v, lerp(u, grad(p[aa+1], x, y, z-1),
				       grad(p[ba+1], x-1, y, z-1)),
			       lerp(u, grad(p[ab+1], x, y-1, z-1),
				       grad(p[bb+1], x-1, y-1, z-1))));
}


} // namespace noise